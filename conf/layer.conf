## conf/layer.conf
```bitbake
# We have a conf and classes directory, add to BBPATH
BBPATH .= ":${LAYERDIR}"

# We have a recipes directory, add to BBFILES
BBFILES += "\
    ${LAYERDIR}/recipes-*/*/*.bb \
    ${LAYERDIR}/recipes-*/*/*.bbappend \
"

BBFILE_COLLECTIONS += "iot-cloud-examples"
BBFILE_PATTERN_iot-cloud-examples := "^${LAYERDIR}/"
BBFILE_PRIORITY_iot-cloud-examples = "10"
LAYERSERIES_COMPAT_iot-cloud-examples = "dunfell"
LAYERDEPENDS_iot-cloud-examples = "\
    openembedded-layer \
    iot-cloud \
"
```
